## src/Kconfig.projbuild
```kconfig
menu "Energy Meter"

config ENERGYMETER_WIFI_SSID
    string "Wi-Fi SSID"
    default ""

config ENERGYMETER_WIFI_PASSWORD
    string "Wi-Fi password"
    default ""

config ENERGYMETER_WIFI_MAXIMUM_RETRY
    int "Wi-Fi reconnect retries before steady retry loop"
    range 1 100
    default 10

config ENERGYMETER_MQTT_URI
    string "MQTT broker URI"
    default "mqtt://192.168.1.1:1883"

config ENERGYMETER_MQTT_USE_TLS
    bool "Enable MQTT TLS certificate bundle"
    default n

config ENERGYMETER_MQTT_USERNAME
    string "MQTT username"
    default ""

config ENERGYMETER_MQTT_PASSWORD
    string "MQTT password"
    default ""

config ENERGYMETER_MQTT_CLIENT_ID
    string "MQTT client ID"
    default ""

config ENERGYMETER_MQTT_BASE_TOPIC
    string "MQTT base topic"
    default "energymeter/t210"

config ENERGYMETER_MQTT_QOS
    int "MQTT QoS"
    range 0 2
    default 1

config ENERGYMETER_PUBLISH_RAW_TELEGRAM
    bool "Publish raw DSMR telegram to <base>/raw"
    default n

config ENERGYMETER_P1_UART_PORT
    int "P1 UART port"
    range 0 1
    default 1

config ENERGYMETER_P1_BAUDRATE
    int "P1 UART baudrate"
    range 1200 921600
    default 115200

config ENERGYMETER_P1_RX_GPIO
    int "P1 RX GPIO"
    range 0 30
    default 20

config ENERGYMETER_P1_RX_INTERNAL_PULLUP
    bool "Enable internal pull-up on P1 RX"
    default y

config ENERGYMETER_P1_REQUEST_GPIO
    int "P1 request GPIO (-1 to disable)"
    range -1 30
    default 21

config ENERGYMETER_P1_REQUEST_ACTIVE_HIGH
    bool "P1 request signal active high"
    default n

config ENERGYMETER_P1_UART_INVERT_RX
    bool "Invert P1 RX signal"
    default y

config ENERGYMETER_P1_REQUIRE_CRC
    bool "Require valid DSMR CRC"
    default y

config ENERGYMETER_UART_BUFFER_SIZE
    int "UART RX buffer size"
    range 256 8192
    default 4096

config ENERGYMETER_TELEGRAM_BUFFER_SIZE
    int "Telegram buffer size"
    range 512 8192
    default 4096

config ENERGYMETER_READER_TASK_STACK
    int "Reader task stack size"
    range 4096 16384
    default 8192

endmenu
```
